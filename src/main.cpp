/*
 * DaisyVideo - video coprocessor firmware for the Daisy computer.
 * Copyright (C) 2026 Joe Cassara
 *
 * This program is free software: you can redistribute it and/or modify
 * it under the terms of the GNU General Public License as published by
 * the Free Software Foundation, either version 3 of the License, or
 * (at your option) any later version.
 *
 * This program is distributed in the hope that it will be useful,
 * but WITHOUT ANY WARRANTY; without even the implied warranty of
 * MERCHANTABILITY or FITNESS FOR A PARTICULAR PURPOSE.  See the
 * GNU General Public License for more details.
 *
 * You should have received a copy of the GNU General Public License
 * along with this program.  If not, see <https://www.gnu.org/licenses/>.
 */

#include <Arduino.h>
#include <pollserial.h>
#include <buffer.h>
#include <avr/wdt.h>
#include <math.h>

/*
 * Based on Dave Schmenk's NTSC bitbanger.
 * Ported to Arduino MEGA and extended to support full 256 character sets,
 * custom characters, additional drawing commands, and packetized serial
 * protocol.
 */

#define DEBUGOUTPUT false

pollserial pserial;

void gotoxy(int x, int y);
void blank_line(void);
void clrscr(byte val);
void newline(void);
void chrout(uint8_t ascii);
void active_line(void);
void scrollscr(void);

#define _CYCLES_PER_US (F_CPU / 1000000)
#define _TIME_HSYNC 4.7
#define _TIME_VSYNC 58.85
#define _TIME_ACTIVE 46
#define _CYCLES_VSYNC ((_TIME_VSYNC * _CYCLES_PER_US) - 1)
#define _CYCLES_HSYNC ((_TIME_HSYNC * _CYCLES_PER_US) - 1)
#define _NTSC_TIME_SCANLINE 63.55
#define _NTSC_TIME_OUTPUT_START 12
#define _NTSC_LINE_FRAME 262
#define _NTSC_LINE_START_VSYNC 0
#define _NTSC_LINE_STOP_VSYNC 3
#define _NTSC_LINE_DISPLAY 216
#define _NTSC_LINE_MID                                                    \
  ((_NTSC_LINE_FRAME - _NTSC_LINE_DISPLAY) / 2 + _NTSC_LINE_DISPLAY / 2 + \
   _NTSC_LINE_STOP_VSYNC)
#define _NTSC_CYCLES_SCANLINE ((_NTSC_TIME_SCANLINE * _CYCLES_PER_US) - 1)
#define _NTSC_CYCLES_OUTPUT_START \
  ((_NTSC_TIME_OUTPUT_START * _CYCLES_PER_US) - 1)
#define PORT_VID PORTE
#define DDR_VID DDRE
#define VID_PIN 0
#define XCK0_DDR DDRE
#define XCK0 2
#define PORT_SYNC PORTB
#define DDR_SYNC DDRB
#define SYNC_PIN 5
#define VID_WIDTH 40
#define VID_HEIGHT 25
#define CELL_WIDTH 8
#define CELL_HEIGHT 8

#define CHAR_RAM true
#define GFX_RAM false

// ===========================================================================
// How the video is generated
// ===========================================================================
//
// There is no video chip here. The ATmega2560 produces a complete composite
// television signal by itself, in software, one scanline at a time.
//
// A composite signal is a single voltage that carries both the picture and
// the timing needed to interpret it. Each scanline begins with a horizontal
// sync pulse, a drop below black that tells the display to start a new line,
// followed by the picture for that line. After the last visible line comes a
// vertical sync, which tells the display to return to the top. Those pulse
// widths are fixed by the NTSC standard and are the _TIME_ values below,
// converted into processor cycles by _CYCLES_PER_US.
//
// Timer1 is configured to run one full period per scanline, so it acts as the
// line clock. Two compare interrupts hang off it: one ends the sync pulse,
// and one fires at the moment picture output must begin. A function pointer,
// line_handler, decides what the second one does, and it is swapped between
// blank_line and active_line as the frame moves in and out of the visible
// region. That pointer swap is cheaper than testing the line number on every
// scanline.
//
// Pixels are shifted out by the USART, not by toggling a pin. The USART is
// put in synchronous master mode, where it clocks bits out of its data
// register at a fixed rate. Writing a byte to it therefore emits eight
// pixels back to back with no processor involvement per pixel, which is the
// only way to reach pixel rates on a 16 MHz part. The pixel clock is set by
// how quickly the code can feed the register, so the instruction count in the
// output loop is part of the timing and cannot be changed freely.
//
// Interrupt latency matters as much as throughput. If the processor is in the
// middle of a long instruction when the timer fires, the handler starts a
// cycle or two late and the line shifts sideways, which the eye sees as a
// ragged edge. The sync handler executes a sleep instruction for this reason:
// waking from sleep takes a fixed number of cycles, so every line starts with
// the same delay instead of a variable one.
//
// The screen is 40 by 25 characters. Glyphs are 8 by 8 pixels and are stored
// as eight 256-byte planes rather than contiguously, so all the row-0 bytes
// sit together, then all the row-1 bytes, and so on. Rendering a scanline
// needs one particular row from every glyph on the line, so this layout turns
// that into a single indexed read per character rather than a multiply.
//
// A second layer gives 80 by 50 pixel graphics by dividing each character
// cell into a 2 by 2 grid and using characters whose bitmaps are the sixteen
// possible quadrant patterns. Dithered variants, where a quadrant is a
// checkerboard rather than solid, extend the same idea to a middle grey. The
// mixed solid and dithered combinations are not in the ROM font, so setup
// generates them at boot.

// Pixel-graphics layer. Each character cell holds a 2 by 2 block of pixels.
#define PIXEL_WIDTH (VID_WIDTH * 2)
#define PIXEL_HEIGHT (VID_HEIGHT * 2)

// Block-graphic character ranges. Codes 0 to 15 use the four low bits as a
// mask of which quadrants are solid. The dithered set mirrors that layout at
// a different base. The mixed set covers combinations of solid and dithered
// quadrants and is looked up through a table rather than computed.
const uint8_t kSolidBlockFirst = 0;
const uint8_t kSolidBlockLast = 15;
const uint8_t kDitherBlockFirst = 160;
const uint8_t kDitherBlockLast = 175;
const uint8_t kMixedBlockFirst = 176;
const uint8_t kMixedBlockLast = 225;
const uint8_t kMixedBlockCount = kMixedBlockLast - kMixedBlockFirst + 1;

// Glyph storage. One character set is eight planes of 256 bytes, one plane
// per pixel row.
const uint16_t kCharsPerSet = 256;
const uint16_t kGlyphRows = 8;
const uint16_t kFontPageBytes = (uint16_t)kCharsPerSet * kGlyphRows;

// Tiles in the logo image are laid out on this pitch in the source ROM.
const uint8_t kLogoTilePitch = 20;

// Boot logo: a block of tiles taken from the graphics ROM.
const uint8_t kLogoFirstChar = 16;
const uint8_t kLogoWidthChars = 20;
const uint8_t kLogoHeightChars = 12;

// Pulled low by DaisyOS once it has booted; until then the logo stays up.
const uint8_t kCpuReadyPin = 52;

// The output-start compare fires this many cycles early to absorb interrupt
// entry overhead, so the first pixel lands at the right place on the line.
const uint8_t kOutputStartLead = 79;


int8_t xpos = 0;
int8_t ypos = 0;
uint8_t videomem[VID_WIDTH * VID_HEIGHT];
uint8_t attrbmem[VID_WIDTH * VID_HEIGHT];
uint8_t* videoptr = videomem;
uint8_t* attrbptr = attrbmem;
uint8_t* videodrawptr = videomem;
int scanline = 0;
void (*line_handler)(void) = &blank_line;
volatile byte vblank = 0;
volatile bool in_vblank = true;
bool inGfxMode = false;
int8_t gfxattrib = 0x00;
pt2Funct pollSerial;

volatile bool auto_advance_cursor = true;
bool reverse_mode = false;
volatile bool auto_scroll = true;

PROGMEM const byte charROM[] = {
    0x00, 0xF0, 0x0F, 0xFF, 0x00, 0xF0, 0x0F, 0xFF, 0x00, 0xF0, 0x0F, 0xFF,
    0x00, 0xF0, 0x0F, 0xFF, 0x80, 0x01, 0xFF, 0x18, 0x18, 0x18, 0x00, 0x18,
    0xFF, 0x18, 0x00, 0x18, 0x00, 0x18, 0x00, 0x18, 0x00, 0x30, 0x6C, 0x6C,
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    0x00, 0x66, 0x00, 0x00, 0x00, 0x00, 0x00, 0x55};

PROGMEM const byte daisyROM[] = {
    0x00, 0x00, 0x00, 0x00, 0x00, 0x00, 0x00, 0x00, 0x00, 0x00, 0x00, 0x00,
    0x00, 0x00, 0x00, 0x00, 0xFF, 0xFF, 0xFF, 0xFF, 0xFF, 0xFF, 0xFF, 0xFF,
    0xFF, 0xFF, 0xFF, 0xFF, 0xFF, 0xFF, 0xFF, 0xFF, 0xFF, 0xFF, 0xFF, 0xFF,
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    0x00, 0x00, 0x00, 0x00, 0x00, 0x00, 0x00, 0x00,
};

uint8_t charRAM[2048];
uint8_t gfxRAM[2048];

static const uint8_t PROGMEM mixedFwd[256] = {
    0, 0,   0,   0,   0,   0,   0,   0,   0,   0,   0,   0,   0,   0,   0,   0,
    0, 0,   176, 0,   177, 0,   178, 0,   179, 0,   180, 0,   181, 0,   182, 0,
    0, 183, 0,   0,   184, 185, 0,   0,   186, 187, 0,   0,   188, 189, 0,   0,
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    0, 0,   0,   0,   0,   0,   0,   0,   0,   0,   0,   0,   0,   0,   0,   0,
};

static const uint8_t PROGMEM mixedRev[50] = {
    0x12, 0x14, 0x16, 0x18, 0x1A, 0x1C, 0x1E, 0x21, 0x24, 0x25,
    0x28, 0x29, 0x2C, 0x2D, 0x34, 0x38, 0x3C, 0x41, 0x42, 0x43,
    0x48, 0x49, 0x4A, 0x4B, 0x52, 0x58, 0x5A, 0x61, 0x68, 0x69,
    0x78, 0x81, 0x82, 0x83, 0x84, 0x85, 0x86, 0x87, 0x92, 0x94,
    0x96, 0xA1, 0xA4, 0xA5, 0xB4, 0xC1, 0xC2, 0xC3, 0xD2, 0xE1,
};

// Decodes a block-graphic character back into its two 4-bit masks: which of
// the cell's four quadrants are solid and which are dithered. Non-graphic
// characters decode to empty so callers can treat any cell uniformly.
static inline void extractPixelBits(uint8_t ch, uint8_t& solid,
                                    uint8_t& dither) {
  if (ch <= kSolidBlockLast) {
    solid = ch;
    dither = 0;
  } else if (ch >= kDitherBlockFirst && ch <= kDitherBlockLast) {
    solid = 0;
    dither = ch - kDitherBlockFirst;
  } else if (ch >= kMixedBlockFirst && ch <= kMixedBlockLast) {
    uint8_t sd = pgm_read_byte(&mixedRev[ch - kMixedBlockFirst]);
    solid = sd >> 4;
    dither = sd & 0x0F;
  } else {
    solid = 0;
    dither = 0;
  }
}

// Inverse of extractPixelBits: picks the character code that renders a given
// combination of solid and dithered quadrants. Pure-solid and pure-dither
// cases are arithmetic; mixed cells need the lookup table.
static inline uint8_t packPixelBits(uint8_t solid, uint8_t dither) {
  if (dither == 0) {
    return solid;
  }
  if (solid == 0) {
    return kDitherBlockFirst + dither;
  }
  return pgm_read_byte(&mixedFwd[(solid << 4) | dither]);
}

#define VID_SETPIX(px, py, on)                                                 \
  do {                                                                         \
    uint8_t _cx = (uint8_t)(px) >> 1, _cy = (uint8_t)(py) >> 1;                \
    if (_cx < VID_WIDTH && _cy < VID_HEIGHT) {                                 \
      uint8_t* _cell = &videodrawptr[_cx + _cy * VID_WIDTH];                   \
      uint8_t _s, _d;                                                          \
      extractPixelBits(*_cell, _s, _d);                                        \
      uint8_t _mask = 1 << (((uint8_t)(px) & 1) | (((uint8_t)(py) & 1) << 1)); \
      _s &= ~_mask;                                                            \
      _d &= ~_mask;                                                            \
      if ((on) == 1)                                                           \
        _s |= _mask;                                                           \
      else if ((on) == 2)                                                      \
        _d |= _mask;                                                           \
      *_cell = packPixelBits(_s, _d);                                          \
    }                                                                          \
  } while (0)

#define VID_GETPIX(px, py)                                                  \
  ({                                                                        \
    uint8_t _c =                                                            \
        videodrawptr[((px) >> 1) + (uint16_t)((py) >> 1) * VID_WIDTH];      \
    uint8_t _s2, _d2;                                                       \
    extractPixelBits(_c, _s2, _d2);                                         \
    uint8_t _mask2 = 1 << (((px) & 1) | (((py) & 1) << 1));                 \
    (_s2 & _mask2) ? (uint8_t)1 : (_d2 & _mask2) ? (uint8_t)2 : (uint8_t)0; \
  })

// Reverses the bits in a byte, swapping progressively smaller groups.
uint8_t bitReverse(uint8_t b) {
  b = (b & 0xF0) >> 4 | (b & 0x0F) << 4;
  b = (b & 0xCC) >> 2 | (b & 0x33) << 2;
  b = (b & 0xAA) >> 1 | (b & 0x55) << 1;
  return b;
}
// Copies a run of glyphs from a PROGMEM font into character RAM. Glyph rows
// are stored in eight 256-byte planes rather than contiguously, so each row
// needs its own copy at a 256-byte stride.
void CopyGlyphs_P(uint16_t from_num, uint16_t to_num, uint16_t num_chars,
                  const uint8_t* from_rom, uint8_t* to_ram) {
  memcpy_P(to_ram + to_num + (0 * 256), from_rom + from_num + (0 * 256),
           num_chars);
  memcpy_P(to_ram + to_num + (1 * 256), from_rom + from_num + (1 * 256),
           num_chars);
  memcpy_P(to_ram + to_num + (2 * 256), from_rom + from_num + (2 * 256),
           num_chars);
  memcpy_P(to_ram + to_num + (3 * 256), from_rom + from_num + (3 * 256),
           num_chars);
  memcpy_P(to_ram + to_num + (4 * 256), from_rom + from_num + (4 * 256),
           num_chars);
  memcpy_P(to_ram + to_num + (5 * 256), from_rom + from_num + (5 * 256),
           num_chars);
  memcpy_P(to_ram + to_num + (6 * 256), from_rom + from_num + (6 * 256),
           num_chars);
  memcpy_P(to_ram + to_num + (7 * 256), from_rom + from_num + (7 * 256),
           num_chars);
}

// CopyGlyphs_P against a chosen 2048-byte font page in ROM.
void CopyGlyphsFromPage_P(uint16_t from_num, uint8_t page, uint16_t to_num,
                          uint16_t num_chars, const uint8_t* from_rom,
                          uint8_t* to_ram) {
  CopyGlyphs_P(from_num + kFontPageBytes * page, to_num, num_chars, from_rom,
               to_ram);
}

// Copies a rectangular block of glyphs, used for multi-cell images whose tiles
// sit on a 20-column pitch in the source ROM.
void CopyGob_P(uint8_t base_char_num, uint8_t width, uint8_t height,
               uint8_t to_num, uint8_t* from_rom, uint8_t* to_ram) {
  for (uint8_t charrow = 0; charrow < height; charrow++) {
    CopyGlyphs_P(base_char_num + (kLogoTilePitch * charrow),
                 to_num + (kLogoTilePitch * charrow), width,
                 from_rom, to_ram);
  }
}

// Loads the boot logo tiles into character RAM.
void CopyGraphics_P(uint8_t* from_rom, uint8_t* to_ram) {
  CopyGob_P(kLogoFirstChar, kLogoWidthChars, kLogoHeightChars, kLogoFirstChar,
            from_rom, to_ram);
}

// Restores the whole character set from ROM, discarding user redefinitions.
void RestoreCharROM(void) {
  CopyGlyphs_P(0, 0, kCharsPerSet, charROM, charRAM);
}

// Inverts every glyph bitmap in place, optionally leaving row 0 of each plane
// alone so the blank character stays blank.
void InvertGlyphs(uint8_t* ram, uint16_t size, bool zero) {
  for (uint16_t index = 0; index < size; index++) {
    if (zero && index % kCharsPerSet == 0) {
      continue;
    }
    *(ram + index) = *(ram + index) ^ 0xff;
  }
}

// Boot. Configures the USART as a synchronous shift register clocked out as
// pixels, sets up Timer1 to free-run at one NTSC scanline per period, clears
// the framebuffers, and pre-renders the 50 mixed solid/dither glyphs that the
// pixel layer needs but the ROM font does not contain.
void setup(void) {
  pinMode(kCpuReadyPin, INPUT_PULLUP);
  pollSerial = pserial.begin(115200);
  cli();
  UBRR0 = 0;
  XCK0_DDR |= _BV(XCK0);
  UCSR0C = _BV(UMSEL00) | _BV(UMSEL01);
  DDR_VID |= _BV(VID_PIN);
  DDR_SYNC |= _BV(SYNC_PIN);
  PORT_VID &= ~_BV(VID_PIN);
  PORT_SYNC |= _BV(SYNC_PIN);
  TCCR1A = _BV(COM1A1) | _BV(COM1A0) | _BV(WGM11);
  TCCR1B = _BV(WGM13) | _BV(WGM12) | _BV(CS10);
  ICR1 = _NTSC_CYCLES_SCANLINE;
  OCR1A = _CYCLES_HSYNC;
  OCR1B = _NTSC_CYCLES_OUTPUT_START - kOutputStartLead;
  TIMSK1 = _BV(OCIE1B);
  TIMSK0 = 0;
  SMCR = _BV(SE);
  memset(videomem, 0x00, sizeof(videomem));
  memset(attrbmem, 0x00, sizeof(attrbmem));
  memset(charRAM, 0x00, sizeof(charRAM));
  memset(gfxRAM, 0x00, sizeof(gfxRAM));
  memcpy_P(gfxRAM, daisyROM, sizeof(gfxRAM));
  sei();
  RestoreCharROM();
#if 0
  InitCustomChars();
#endif

  for (uint8_t i = 0; i < kMixedBlockCount; i++) {
    uint8_t sd = pgm_read_byte(&mixedRev[i]);
    uint8_t solidBits = sd >> 4, ditherBits = sd & 0x0F;
    uint8_t ch = kMixedBlockFirst + i;
    for (uint8_t row = 0; row < 8; row++) {
      uint8_t leftBit = (row < 4) ? 0 : 2;
      uint8_t rightBit = (row < 4) ? 1 : 3;
      uint8_t ls = (solidBits >> leftBit) & 1
                       ? 1
                       : ((ditherBits >> leftBit) & 1 ? 2 : 0);
      uint8_t rs = (solidBits >> rightBit) & 1
                       ? 1
                       : ((ditherBits >> rightBit) & 1 ? 2 : 0);
      uint8_t lb = (ls == 1) ? 0xF0 : (ls == 2) ? ((row & 1) ? 0x50 : 0xA0) : 0;
      uint8_t rb = (rs == 1) ? 0x0F : (rs == 2) ? ((row & 1) ? 0x05 : 0x0A) : 0;
      charRAM[ch + row * kCharsPerSet] = lb | rb;
    }
  }
}
// End of horizontal sync. Re-enables interrupts and sleeps so the CPU wakes on
// the next compare with predictable latency -- sleeping is what keeps the
// wake-up jitter low enough for a stable picture.
ISR(TIMER1_COMPA_vect) {
  sei();
  asm("sleep\n");
}

// Fires once per scanline at the point where pixel output must begin. Calls
// whichever line handler is active, then services the serial port in the time
// left over.
ISR(TIMER1_COMPB_vect) {
  line_handler();
  scanline++;
  pollSerial();
}
// Scanline handler for the non-visible part of the frame. Manages vertical
// sync width and, at the top of the display window, resets the framebuffer
// pointers and switches over to active_line.
void blank_line(void) {
  pollSerial();
  if (scanline == _NTSC_LINE_STOP_VSYNC) {
    OCR1A = _CYCLES_HSYNC;
  } else if (scanline == _NTSC_LINE_MID - (VID_HEIGHT * CELL_HEIGHT) / 2) {
    TIMSK1 = _BV(OCIE1A) | _BV(OCIE1B);
    videoptr = videomem;
    attrbptr = attrbmem;
    line_handler = &active_line;
    in_vblank = false;
    inGfxMode = ((*attrbptr & 0x0F) == 0x01);
    gfxattrib = ((*attrbptr & 0xF0) == 0xF0) ? 0xff : 0x00;
  } else if (scanline > _NTSC_LINE_FRAME) {
    OCR1A = _CYCLES_VSYNC;
    scanline = 0;
  }
}

// Scanline handler that shifts one row of pixels out of the USART. Reads each
// cell's glyph row from character or graphics RAM and XORs the attribute byte
// to apply reverse video. The leading zero writes produce the back porch, and
// the instruction count in these loops sets the pixel clock -- do not add work
// here. Advances to the next text row every CELL_HEIGHT scanlines.
void active_line(void) {
  register uint8_t* charPtr = videoptr;
  register uint8_t* attribute = attrbptr;

  register uint8_t gfxattrb = gfxattrib;
  uint8_t p;
  static byte charRow = 0;
  register int charCol_offset = (charRow << 8);
  p = VID_WIDTH;

  UCSR0B = _BV(TXEN0);
  while ((UCSR0A & _BV(UDRE0)) == 0) {
  }
  UDR0 = 0;
  while ((UCSR0A & _BV(UDRE0)) == 0) {
  }
  UDR0 = 0;
  while ((UCSR0A & _BV(UDRE0)) == 0) {
  }
  UDR0 = 0;

  if (inGfxMode) {
    while ((UCSR0A & _BV(UDRE0)) == 0) {
  }
    UDR0 = 0;
    while (p--) {
      UDR0 = gfxRAM[charCol_offset + *charPtr++] ^ gfxattrb;
      asm("nop");
      asm("nop");
    }
  } else {
    while ((UCSR0A & _BV(UDRE0)) == 0) {
  }
    UDR0 = 0;
    while (p--) {
      UDR0 = charRAM[charCol_offset + *charPtr++] ^ *(attribute++);
    }
  }
  while ((UCSR0A & _BV(TXC0)) == 0) {
  }
  UCSR0B = 0;
  if (++charRow == CELL_HEIGHT) {
    charRow = 0;
    if (scanline == _NTSC_LINE_MID + (VID_HEIGHT * CELL_HEIGHT) / 2) {
      TIMSK1 = _BV(OCIE1B);
      line_handler = &blank_line;
      vblank = 1;
      in_vblank = true;
    } else {
      videoptr += VID_WIDTH;
      attrbptr += VID_WIDTH;
      inGfxMode = ((*attrbptr & 0x0F) == 0x01);
      gfxattrib = (*attrbptr & 0xF0) == 0xF0 ? 0xff : 0x00;
    }
  }
}
// Writes one character at the cursor and advances it, wrapping and scrolling
// at the screen edges. Carriage return is handled as a newline.
void chrout(uint8_t ascii) {
  if (ascii == 13) {
    newline();
    return;
  }
  if (ascii <= 255) {
    uint16_t cell = (uint16_t)xpos + (uint16_t)ypos * VID_WIDTH;
    videodrawptr[cell] = ascii;
    attrbmem[cell] = reverse_mode ? 0xFF : 0x00;
    if (auto_advance_cursor) {
      xpos++;
      if (xpos >= VID_WIDTH) {
        xpos = 0;
        ypos++;
        if (ypos >= VID_HEIGHT) {
          if (auto_scroll) {
            scrollscr();
          }
          xpos = 0;
          ypos = VID_HEIGHT - 1;
        }
      }
    }
  }
}

// chrout, but forces the target cell to reverse video first.
void chrout_reverse(uint8_t ascii) {
  attrbmem[xpos + ypos * VID_WIDTH] = 0xff;
  chrout(ascii);
}

// Fills the screen with one character and resets every attribute to the
// current video polarity.
void clrscr(byte val) {
  memset(videodrawptr, val, sizeof(videomem));
  memset(attrbmem, reverse_mode ? 0xFF : 0x00, sizeof(attrbmem));
}
// Scrolls the display up one text row and blanks the bottom row, moving
// characters and attributes together so highlighting travels with its text.
void scrollscr(void) {
  for (uint8_t line = 1; line < VID_HEIGHT; line++) {
    memcpy(&videodrawptr[(line - 1) * VID_WIDTH],
           &videodrawptr[VID_WIDTH * line], VID_WIDTH);
    memcpy(&attrbmem[(line - 1) * VID_WIDTH], &attrbmem[VID_WIDTH * line],
           VID_WIDTH);
  }
  memset(&videodrawptr[(VID_HEIGHT - 1) * VID_WIDTH], 0x00, VID_WIDTH);
  memset(&attrbmem[(VID_HEIGHT - 1) * VID_WIDTH], reverse_mode ? 0xFF : 0x00,
         VID_WIDTH);
}
// Writes a NUL-terminated string at the cursor.
void printstr(char* string) {
  while (*string) {
    chrout(*string++);
  }
}
// Writes a string horizontally centred on the given row.
void centerstr(char* string, uint8_t y) {
  uint8_t x = (VID_WIDTH / 2) - (uint8_t)strlen(string) / 2;
  gotoxy(x, y);
  printstr(string);
}
// Moves the cursor, ignoring either coordinate that falls outside the screen
// so a bad value cannot park the cursor off-screen.
void gotoxy(int x, int y) {
  if (x != xpos) {
    if (x >= 0 && x < VID_WIDTH) {
      xpos = x;
    }
  }
  if (y != ypos) {
    if (y >= 0 && y < VID_HEIGHT) {
      ypos = y;
    }
  }
}

// Moves to the start of the next row, scrolling if that runs past the bottom.
void newline(void) {
  xpos = 0;
  ypos++;
  if (ypos >= VID_HEIGHT) {
    if (auto_scroll) {
      scrollscr();
    }
    xpos = 0;
    ypos = VID_HEIGHT - 1;
  }
}

typedef enum {
  kCursorUp = 1,
  kCursorRight = 2,
  kCursorDown = 3,
  kCursorLeft = 4,
} CursorDirection;

// Moves the cursor one cell, clamping at the screen edges rather than wrapping.
void movecursor(CursorDirection direction) {
  switch (direction) {
    case kCursorUp: {
      ypos--;
      if (ypos < 0) {
        ypos = 0;
      }
      break;
    }
    case kCursorRight: {
      xpos++;
      if (xpos == VID_WIDTH) {
        if (ypos == VID_HEIGHT - 1) {
          if (auto_scroll) {
            scrollscr();
          }
          xpos = 0;
        } else {
          xpos = 0;
          ypos++;
        }
      }
      break;
    }
    case kCursorDown: {
      ypos++;
      if (ypos == VID_HEIGHT) {
        if (auto_scroll) {
          scrollscr();
        }
        ypos = VID_HEIGHT - 1;
      }
      break;
    }
    case kCursorLeft: {
      xpos--;
      if (xpos < 0) {
        if (ypos != 0) {
          xpos = VID_WIDTH - 1;
          ypos--;
        } else {
          xpos = 0;
        }
      }
      break;
    }
    default:
      break;
  }
}

// Turns on one pixel in the 80x50 block-graphics layer. Each character cell
// holds a 2x2 quadrant, so the pixel maps to one bit of one cell.
void setpix(signed char x, signed char y) {
  byte xChar, yChar, blockChar;

  if (x > 79 || x < 0 || y > 49 || y < 0) {
    return;
  }
  xChar = x >> 1;
  yChar = y >> 1;
  blockChar = 1 << ((x & 1) | ((y & 1) << 1));
  videodrawptr[xChar + yChar * VID_WIDTH] |= blockChar;
}
// Clears one pixel, leaving the other three quadrants of the cell alone.
void clrpix(signed char x, signed char y) {
  byte xChar, yChar, blockChar;

  if (x > 79 || x < 0 || y > 49 || y < 0) {
    return;
  }
  xChar = x >> 1;
  yChar = y >> 1;
  blockChar = 1 << ((x & 1) | ((y & 1) << 1));
  videodrawptr[xChar + yChar * VID_WIDTH] &= ~blockChar;
}
// Flips one pixel. Useful for drawing that can be undone by redrawing.
void xorpix(signed char x, signed char y) {
  byte xChar, yChar, blockChar;

  if (x > 79 || x < 0 || y > 49 || y < 0) {
    return;
  }
  xChar = x >> 1;
  yChar = y >> 1;
  blockChar = 1 << ((x & 1) | ((y & 1) << 1));
  videodrawptr[xChar + yChar * VID_WIDTH] ^= blockChar;
}
// Bresenham line between two pixels. The per-pixel operation is passed in, so
// the same walk serves set, clear, and xor drawing.
void line(signed char x1, signed char y1, signed char x2, signed char y2,
          void (*oppix)(signed char x, signed char y)) {
  signed char dx, dy, sx, sy, dx2, dy2, dd2, err;

  if (x2 >= x1) {
    dx = x2 - x1;
    sx = 1;
  } else {
    dx = x1 - x2;
    sx = -1;
  }
  if (y2 >= y1) {
    dy = y2 - y1;
    sy = 1;
  } else {
    dy = y1 - y2;
    sy = -1;
  }
  dx2 = dx << 1;
  dy2 = dy << 1;
  if (dx >= dy) {
    err = dx - dy2;
    dd2 = dx2 - dy2;
    while (x1 != x2) {
      oppix(x1, y1);
      x1 += sx;
      if (err < 0) {
        err += dd2;
        y1 += sy;
      } else {
        err -= dy2;
      }
    }
  } else {
    err = dy - dx2;
    dd2 = dy2 - dx2;
    while (y1 != y2) {
      oppix(x1, y1);
      y1 += sy;
      if (err < 0) {
        err += dd2;
        x1 += sx;
      } else {
        err -= dx2;
      }
    }
  }
  oppix(x2, y2);
}

uint16_t count = 0;
uint16_t count2 = 0;
bool failed = false;
char data[255];
char* dataptr = data;
char in_data;

const uint8_t kSOP = 0x5c;
const uint8_t kMinFrameSize = 4;
const uint8_t kOffsetPayloadLen = 2;

// Two's-complement checksum over a frame, so a valid frame plus its checksum
// byte sums to zero. Must match the sender in DaisyOS.
uint8_t calcchecksum(uint8_t* data_in, size_t data_len) {
  uint8_t raw_sum = 0;

  for (size_t i = 0; i < data_len; i++) {
    raw_sum += data_in[i];
  }

  return (uint8_t)(~raw_sum + 1);
}

// Redefines one glyph from eight bitmap rows, writing each row into its own
// 256-byte plane.
void DefineChar(bool char_ram, uint8_t* payload) {
  uint8_t ch = payload[0];
  uint8_t* ram_ptr;

  ram_ptr = char_ram ? charRAM : gfxRAM;

  for (uint16_t row = 0; row < 8; row++) {
    ram_ptr[ch + (256 * row)] = payload[row + 1];
  }
}

// Restores a single glyph from the ROM font.
void ResetChar(bool char_ram, uint8_t* payload) {
  uint8_t ch = payload[0];
  if (char_ram) {
    CopyGlyphs_P(ch, ch, 1, charROM, charRAM);
  } else {
    CopyGlyphs_P(ch, ch, 1, charROM, gfxRAM);
  }
}

typedef enum {
  kVideoPutStringAt = 0x01,
  kVideoPutAttribsAt = 0x02,
  kVideoToggleAttribAtCursor = 0x03,
  kVideoClearAttributeAtCursor = 0x06,
  kVideoCharOutAt = 0x04,
  kVideoLocateCursor = 0x05,
  kVideoClearScreen = 0x10,
  kVideoReverseScreen = 0x11,
  kVideoSetReverseMode = 0x12,
  kVideoSetCursorAdvance = 0x40,
  kVideoNewline = 0x41,
  kVideoCursorMove = 0x43,
  kVideoSetScrollLock = 0x44,
  kVideoScrollScreen = 0x45,
  kVideoSetPixel = 0x50,
  kVideoDrawLine = 0x51,
  kVideoDrawCircle = 0x52,
  kVideoFloodFill = 0x53,
  kVideoDefineChar = 0x60,
  kVideoResetChar = 0x61,
  kVideoDefineGfx = 0x62,
  kVideoResetGfx = 0x63,
  kVideoDefineCharBulk = 0x64,
  kVideoDefineGfxBulk = 0x65,
  kVideoCopyChar = 0x66,
  kVideoPlotChar = 0x70,
  kVideoFillCells = 0x71,
  kVideoMoveBlock = 0x72,
  kVideoFillBlock = 0x73,
  kVideoDrawToSecondPage = 0x74,
  kVideoCopyFromSecondPage = 0x75,
  kVideoDrawToPrimaryPage = 0x76,
  kVideoScrollX = 0x77,
  kVideoDrawPoly = 0x54,
} VideoMsgId;

// Fills a rectangle, cycling through the character range as it goes. Clipped
// cells still advance the counter so the pattern stays aligned to the full
// rectangle rather than shifting at the screen edge.
void FillBlock(uint8_t x, uint8_t y, uint8_t w, uint8_t h, uint8_t startChar,
               uint8_t endChar) {
  if (x < VID_WIDTH && y < VID_HEIGHT && w > 0 && h > 0) {
    uint8_t ch = startChar;
    for (uint8_t row = 0; row < h; row++) {
      uint8_t cellY = y + row;
      if (cellY >= VID_HEIGHT) {
        break;
      }
      uint8_t colW = w;
      if (x + colW > VID_WIDTH) {
        colW = VID_WIDTH - x;
      }
      for (uint8_t col = 0; col < colW; col++) {
        uint16_t c = (uint16_t)cellY * VID_WIDTH + x + col;
        videodrawptr[c] = ch;
        if (ch == endChar) {
          ch = startChar;
        } else {
          ch++;
        }
      }
      uint8_t skip = w - colW;
      for (uint8_t s = 0; s < skip; s++) {
        if (ch == endChar) {
          ch = startChar;
        } else {
          ch++;
        }
      }
    }
  }
}

// Switches the logo's rows to the graphics character set.
void SetGfxBlock(void) {
  attrbmem[40 * 10] = 0x01;
  attrbmem[40 * 11] = 0x01;
  attrbmem[40 * 12] = 0x01;
  attrbmem[40 * 13] = 0x01;
  attrbmem[40 * 14] = 0x01;
  attrbmem[40 * 15] = 0x01;
}

// Draws the boot logo, shown until DaisyOS signals that it is up.
void showlogo(void) {
  SetGfxBlock();
  FillBlock(0, 10, 39, 5, 16, 255);
}

// Validates a complete frame's checksum and dispatches the drawing command it
// carries. A frame that fails the checksum is dropped silently.
bool HandleDisplayCommand(Buffer* buffer) {
  const uint8_t msg_id = buffer->buffer[1];
  const uint8_t payload_len = buffer->buffer[2];
  const uint8_t checksum = buffer->buffer[buffer->buffer_len - 1];
  uint8_t* payload = &(buffer->buffer[3]);
  uint8_t calc_checksum = calcchecksum(buffer->buffer, buffer->buffer_len - 1);
  if (checksum == calc_checksum) {
    switch (msg_id) {
      case kVideoPutStringAt: {
        uint16_t vidmemcell = 0;
        vidmemcell = buffer->buffer[3] << 8;
        vidmemcell |= buffer->buffer[4];
        uint8_t slen = payload_len - 2;
        memcpy(videodrawptr + vidmemcell, payload + 2, slen);
        memset(attrbmem + vidmemcell, reverse_mode ? 0xFF : 0x00, slen);
        break;
      }
      case kVideoPutAttribsAt: {
        uint16_t atremcell = 0;
        atremcell = (buffer->buffer[3] << 8);
        atremcell |= (buffer->buffer[4]);
        memcpy(attrbmem + atremcell, payload + 2, payload_len - 2);
        break;
      }

      case kVideoToggleAttribAtCursor: {
        attrbmem[(40 * ypos) + xpos] = ~attrbmem[(40 * ypos) + xpos];
        break;
      }

      case kVideoClearAttributeAtCursor: {
        attrbmem[(40 * ypos) + xpos] = 0x0;
        break;
      }

      case kVideoCharOutAt: {
        uint8_t c = payload[0];
        chrout(c);
        break;
      }

      case kVideoLocateCursor: {
        uint8_t x = payload[0];
        uint8_t y = payload[1];
        xpos = x;
        ypos = y;
        break;
      }

      case kVideoClearScreen: {
        clrscr(payload[0]);
        break;
      }

      case kVideoReverseScreen: {
        reverse_mode = (payload[0] == 1);
        memset(attrbmem, reverse_mode ? 0xFF : 0x00, sizeof(attrbmem));
        break;
      }

      case kVideoSetReverseMode: {
        reverse_mode = (payload[0] == 1);
        break;
      }

      case kVideoSetCursorAdvance: {
        bool advance = (payload[0] == 1);
        auto_advance_cursor = advance;
        break;
      }

      case kVideoNewline: {
        newline();
        break;
      }

      case kVideoCursorMove: {
        movecursor((CursorDirection)payload[0]);
        break;
      }

      case kVideoSetScrollLock: {
        auto_scroll = payload[0] == 0 ? true : false;
        break;
      }

      case kVideoScrollScreen: {
        scrollscr();
        break;
      }

      case kVideoSetPixel: {
        VID_SETPIX(payload[0], payload[1], payload[2]);
        break;
      }

      case kVideoDrawLine: {
        int cx0 = payload[0], cy0 = payload[1];
        int cx1 = payload[2], cy1 = payload[3];
        uint8_t on = payload[4];
        int dx = abs(cx1 - cx0), dy = -abs(cy1 - cy0);
        int sx = cx0 < cx1 ? 1 : -1, sy = cy0 < cy1 ? 1 : -1;
        int err = dx + dy;
        for (;;) {
          VID_SETPIX((uint8_t)cx0, (uint8_t)cy0, on);
          if (cx0 == cx1 && cy0 == cy1) {
            break;
          }
          int e2 = 2 * err;
          if (e2 >= dy) {
            err += dy;
            cx0 += sx;
          }
          if (e2 <= dx) {
            err += dx;
            cy0 += sy;
          }
        }
        break;
      }

      case kVideoDrawCircle: {
        int cx = payload[0], cy = payload[1];
        int rx = payload[2], ry = payload[3];
        if (rx == 0 && ry == 0) {
          break;
        }
        uint8_t on = payload[4];
        uint16_t s_deg = ((uint16_t)payload[5] << 8) | payload[6];
        uint16_t e_deg = ((uint16_t)payload[7] << 8) | payload[8];
        bool full = (s_deg == 0 && e_deg == 360);

#define CIRC_PIX(px, py)                                    \
  do {                                                      \
    if ((px) >= 0 && (px) < 80 && (py) >= 0 && (py) < 50) { \
      VID_SETPIX((uint8_t)(px), (uint8_t)(py), on);         \
    }                                                       \
  } while (0)

#define VID_PT(dx, dy)                                                      \
  do {                                                                      \
    if (full) {                                                             \
      CIRC_PIX(cx + (dx), cy + (dy));                                       \
    } else {                                                                \
      float _ang = atan2f(-(float)(dy), (float)(dx)) * (180.0f / M_PI);     \
      if (_ang < 0.0f) _ang += 360.0f;                                      \
      int _a = (int)_ang;                                                   \
      bool _ok = (s_deg <= e_deg) ? (_a >= (int)s_deg && _a <= (int)e_deg)  \
                                  : (_a >= (int)s_deg || _a <= (int)e_deg); \
      if (_ok) {                                                            \
        CIRC_PIX(cx + (dx), cy + (dy));                                     \
      }                                                                     \
    }                                                                       \
  } while (0)

        int32_t a2 = (int32_t)rx * rx, b2 = (int32_t)ry * ry;
        int32_t fa2 = 4 * a2, fb2 = 4 * b2;
        int32_t x, y, sigma;

        x = 0;
        y = ry;
        sigma = 2 * b2 + a2 * (1L - 2L * ry);
        for (; b2 * x <= a2 * y; x++) {
          VID_PT(x, y);
          VID_PT(-x, y);
          VID_PT(x, -y);
          VID_PT(-x, -y);
          if (sigma >= 0) {
            sigma += fa2 * (1L - y);
            y--;
          }
          sigma += b2 * (4L * x + 6L);
        }

        x = rx;
        y = 0;
        sigma = 2 * a2 + b2 * (1L - 2L * rx);
        for (; a2 * y <= b2 * x; y++) {
          VID_PT(x, y);
          VID_PT(-x, y);
          VID_PT(x, -y);
          VID_PT(-x, -y);
          if (sigma >= 0) {
            sigma += fb2 * (1L - x);
            x--;
          }
          sigma += a2 * (4L * y + 6L);
        }

#undef VID_PT
#undef CIRC_PIX
        break;
      }

      case kVideoFloodFill: {
        uint8_t sx = payload[0], sy = payload[1];
        uint8_t fill_val = payload[2];

        if (sx >= 80 || sy >= 50) {
          break;
        }

        uint8_t target = VID_GETPIX(sx, sy);
        if (target > 2 || target == fill_val) {
          break;
        }

        static uint8_t pfx[256], pfy[256];
        int sp = 0;

        VID_SETPIX(sx, sy, fill_val);
        pfx[0] = sx;
        pfy[0] = sy;
        sp = 1;

        static const int8_t ndx[4] = {0, 0, 1, -1};
        static const int8_t ndy[4] = {-1, 1, 0, 0};

        while (sp > 0) {
          sp--;
          uint8_t cx = pfx[sp], cy = pfy[sp];
          for (uint8_t d = 0; d < 4; d++) {
            int nx = (int)cx + ndx[d], ny = (int)cy + ndy[d];
            if (nx < 0 || nx >= 80 || ny < 0 || ny >= 50) {
              continue;
            }
            if (VID_GETPIX(nx, ny) == target) {
              VID_SETPIX((uint8_t)nx, (uint8_t)ny, fill_val);
              if (sp < 256) {
                pfx[sp] = (uint8_t)nx;
                pfy[sp] = (uint8_t)ny;
                sp++;
              }
            }
          }
        }

        break;
      }

      case kVideoDefineChar: {
        DefineChar(CHAR_RAM, payload);
        break;
      }
      case kVideoResetChar: {
        ResetChar(CHAR_RAM, payload);
        break;
      }

      case kVideoDefineGfx: {
        DefineChar(GFX_RAM, payload);
        break;
      }
      case kVideoResetGfx: {
        ResetChar(GFX_RAM, payload);
        break;
      }

      case kVideoDefineCharBulk:
      case kVideoDefineGfxBulk: {
        uint8_t* ram_ptr = (msg_id == kVideoDefineCharBulk) ? charRAM : gfxRAM;
        uint8_t startCh = payload[0];
        uint8_t count = (payload_len - 1) / 8;
        for (uint8_t n = 0; n < count; n++) {
          uint8_t ch = startCh + n;
          for (uint8_t row = 0; row < 8; row++) {
            ram_ptr[ch + 256 * row] = payload[1 + n * 8 + row];
          }
        }
        break;
      }

      case kVideoCopyChar: {
        uint8_t flags = payload[0];
        uint8_t* srcRAM = (flags & 0x01) ? gfxRAM : charRAM;
        uint8_t* dstRAM = (flags & 0x02) ? gfxRAM : charRAM;
        uint8_t start = payload[1];
        uint8_t end = payload[2];
        if (srcRAM == dstRAM) {
          for (uint8_t row = 0; row < 8; row++) {
            dstRAM[end + 256 * row] = srcRAM[start + 256 * row];
          }
        } else {
          uint8_t last = (end >= start) ? end : start;
          uint8_t ch = start;
          for (;;) {
            for (uint8_t row = 0; row < 8; row++) {
              dstRAM[ch + 256 * row] = srcRAM[ch + 256 * row];
            }
            if (ch == last) {
              break;
            }
            ch++;
          }
        }
        break;
      }

      case kVideoPlotChar: {
        uint8_t x = payload[0];
        uint8_t y = payload[1];
        uint8_t ch = payload[2];
        if (x < VID_WIDTH && y < VID_HEIGHT) {
          videodrawptr[(uint16_t)x + (uint16_t)y * VID_WIDTH] = ch;
        }
        break;
      }

      case kVideoFillCells: {
        uint8_t x = payload[0];
        uint8_t y = payload[1];
        uint8_t ch = payload[2];
        uint8_t count = payload[3];
        if (x < VID_WIDTH && y < VID_HEIGHT && count > 0) {
          uint16_t cell = (uint16_t)x + (uint16_t)y * VID_WIDTH;
          uint16_t available = (uint16_t)(VID_WIDTH * VID_HEIGHT) - cell;
          if (count > available) {
            count = (uint8_t)available;
          }
          memset(videodrawptr + cell, ch, count);
          memset(attrbmem + cell, reverse_mode ? 0xFF : 0x00, count);
        }
        break;
      }

      case kVideoMoveBlock: {
        uint8_t fromX = payload[0];
        uint8_t fromY = payload[1];
        uint8_t toX = payload[2];
        uint8_t toY = payload[3];
        uint8_t w = payload[4];
        uint8_t h = payload[5];
        if (fromX < VID_WIDTH && fromY < VID_HEIGHT && toX < VID_WIDTH &&
            toY < VID_HEIGHT && w > 0 && h > 0) {
          uint8_t fillAttr = reverse_mode ? 0xFF : 0x00;
          if (toY < fromY) {
            for (uint8_t row = 0; row < h; row++) {
              uint8_t srcY = fromY + row;
              uint8_t dstY = toY + row;
              if (srcY >= VID_HEIGHT || dstY >= VID_HEIGHT) {
                break;
              }
              uint8_t rowW = w;
              if (fromX + rowW > VID_WIDTH) {
                rowW = VID_WIDTH - fromX;
              }
              if (toX + rowW > VID_WIDTH) {
                uint8_t lim = VID_WIDTH - toX;
                if (lim < rowW) {
                  rowW = lim;
                }
              }
              memmove(videodrawptr + dstY * VID_WIDTH + toX,
                      videodrawptr + srcY * VID_WIDTH + fromX, rowW);
              memmove(attrbmem + dstY * VID_WIDTH + toX,
                      attrbmem + srcY * VID_WIDTH + fromX, rowW);
            }
          } else {
            for (int8_t row = h - 1; row >= 0; row--) {
              uint8_t srcY = fromY + row;
              uint8_t dstY = toY + row;
              if (srcY >= VID_HEIGHT || dstY >= VID_HEIGHT) {
                continue;
              }
              uint8_t rowW = w;
              if (fromX + rowW > VID_WIDTH) {
                rowW = VID_WIDTH - fromX;
              }
              if (toX + rowW > VID_WIDTH) {
                uint8_t lim = VID_WIDTH - toX;
                if (lim < rowW) {
                  rowW = lim;
                }
              }
              memmove(videodrawptr + dstY * VID_WIDTH + toX,
                      videodrawptr + srcY * VID_WIDTH + fromX, rowW);
              memmove(attrbmem + dstY * VID_WIDTH + toX,
                      attrbmem + srcY * VID_WIDTH + fromX, rowW);
            }
          }
          if (payload_len >= 7) {
            uint8_t fillChar = payload[6];
            uint8_t srcRowW = w;
            if (fromX + (uint16_t)srcRowW > VID_WIDTH) {
              srcRowW = VID_WIDTH - fromX;
            }
            uint8_t srcEndX = fromX + srcRowW;
            uint8_t dstEndX = toX + w;
            if (dstEndX > VID_WIDTH) {
              dstEndX = VID_WIDTH;
            }
            uint8_t xOvStart = (fromX > toX) ? fromX : toX;
            uint8_t xOvEnd = (srcEndX < dstEndX) ? srcEndX : dstEndX;
            bool hasXOverlap = xOvStart < xOvEnd;
            for (uint8_t row = 0; row < h; row++) {
              uint8_t srcY = fromY + row;
              if (srcY >= VID_HEIGHT) {
                break;
              }
              bool yOverlap = (srcY >= toY && srcY < (uint16_t)(toY + h));
              if (!yOverlap || !hasXOverlap) {
                memset(videodrawptr + srcY * VID_WIDTH + fromX, fillChar,
                       srcRowW);
                memset(attrbmem + srcY * VID_WIDTH + fromX, fillAttr, srcRowW);
              } else {
                if (xOvStart > fromX) {
                  memset(videodrawptr + srcY * VID_WIDTH + fromX, fillChar,
                         xOvStart - fromX);
                  memset(attrbmem + srcY * VID_WIDTH + fromX, fillAttr,
                         xOvStart - fromX);
                }
                if (xOvEnd < srcEndX) {
                  memset(videodrawptr + srcY * VID_WIDTH + xOvEnd, fillChar,
                         srcEndX - xOvEnd);
                  memset(attrbmem + srcY * VID_WIDTH + xOvEnd, fillAttr,
                         srcEndX - xOvEnd);
                }
              }
            }
          }
        }
        break;
      }

      case kVideoFillBlock: {
        uint8_t x = payload[0];
        uint8_t y = payload[1];
        uint8_t w = payload[2];
        uint8_t h = payload[3];
        uint8_t startChar = payload[4];
        uint8_t endChar = payload[5];
        FillBlock(x, y, w, h, startChar, endChar);
        break;
      }

      case kVideoScrollX: {
        uint8_t sy = payload[0];
        uint8_t sh = payload[1];
        int8_t dir = (int8_t)payload[2];
        if (sy < VID_HEIGHT && sh > 0 && dir != 0) {
          int s = (int)dir % (int)VID_WIDTH;
          if (s < 0) s += VID_WIDTH;
          uint8_t shift = (uint8_t)s;
          while (!in_vblank) {
          }
          uint8_t tmp[VID_WIDTH];
          for (uint8_t row = 0; row < sh; row++) {
            uint8_t cy = sy + row;
            if (cy >= VID_HEIGHT) {
              break;
            }
            uint8_t* line = videodrawptr + cy * VID_WIDTH;
            memcpy(tmp, line, VID_WIDTH);
            memcpy(line + shift, tmp, VID_WIDTH - shift);
            memcpy(line, tmp + VID_WIDTH - shift, shift);
          }
        }
        break;
      }

      case kVideoDrawPoly: {
        uint8_t nE = payload[0];
        uint8_t nD = payload[1];
        uint8_t* pts = &payload[2];

        for (uint8_t pass = 0; pass < 2; pass++) {
          uint8_t n = (pass == 0) ? nE : nD;
          uint8_t off = (pass == 0) ? 0 : nE * 2;
          uint8_t on = (pass == 0) ? 0 : 1;
          if (n == 0) {
            continue;
          }

          for (uint8_t i = 0; i < n; i++) {
            uint8_t i2 = (i + 1 < n) ? i + 1 : 0;
            int cx0 = (int8_t)pts[off + i * 2],
                cy0 = (int8_t)pts[off + i * 2 + 1];
            int cx1 = (int8_t)pts[off + i2 * 2],
                cy1 = (int8_t)pts[off + i2 * 2 + 1];
            int dx = abs(cx1 - cx0), dy = -abs(cy1 - cy0);
            int sx = cx0 < cx1 ? 1 : -1, sy = cy0 < cy1 ? 1 : -1;
            int err = dx + dy;
            for (;;) {
              if (cx0 >= 0 && cx0 < 80 && cy0 >= 0 && cy0 < 50) {
                VID_SETPIX((uint8_t)cx0, (uint8_t)cy0, on);
              }
              if (cx0 == cx1 && cy0 == cy1) {
                break;
              }
              int e2 = 2 * err;
              if (e2 >= dy) {
                err += dy;
                cx0 += sx;
              }
              if (e2 <= dx) {
                err += dx;
                cy0 += sy;
              }
            }
          }
        }
        break;
      }

      default: {
        if (DEBUGOUTPUT) printstr("?VMSG");
        return false;
        break;
      }
    }
  } else {
    if (DEBUGOUTPUT) printstr("?VSUM");
    return false;
  }
  return true;
}

// Drains the UART, reassembling framed commands. Bytes outside a frame are
// discarded until a start-of-packet marker appears, so the link resynchronises
// on its own after a garbled frame. Called from the scanline ISR.
bool PollSerial() {
  static Buffer buffer;
  static uint8_t data = 0;
  while (pserial.available()) {
    data = pserial.read();
    if (buffer.in_frame == false && data == kSOP) {
      BufferInit(&buffer);
      buffer.in_frame = true;
    }
    if (buffer.in_frame == true) {
      BufferAdd(data, &buffer);
      if (buffer.buffer_len ==
          (uint16_t)kMinFrameSize + buffer.buffer[kOffsetPayloadLen]) {
        HandleDisplayCommand(&buffer);
        BufferInit(&buffer);
      }
    } else {
    }
  }
  return true;
}

// Reboots via watchdog timeout, on request from DaisyOS.
void resetArduino() {
  wdt_enable(WDTO_15MS);
  while (1) {
  }
}

bool cpu_ready = false;
// Holds the logo on screen until DaisyOS pulls the ready line low, then clears
// the screen and idles. All real work happens in the scanline ISR.
void loop(void) {
  static bool logoshown = false;

  while (!cpu_ready) {
    cpu_ready = digitalRead(kCpuReadyPin) == LOW;
    if (cpu_ready) {
      memset(videomem, 0, sizeof(videomem));
      xpos = 0;
      ypos = 0;
    } else {
      if (!logoshown) {
        showlogo();
      }
    }
  }

  PollSerial();
  if (vblank) {
    vblank = 0;
    if (digitalRead(52) == HIGH) {
      resetArduino();
    }
  }
}
